// Connections
//5v--------------------VCC
//GND-----------------GND
//SDA/A4--------------SDA
//SCL/A5---------------SCL

// Olivier Laflamme Christmas Tree 

#include <Wire.h>
#include <Adafruit_GFX.h>
#include <Adafruit_SSD1306.h>

#define OLED_RESET 4
Adafruit_SSD1306 display(128, 64, &Wire, OLED_RESET);

#define NUMFLAKES     15 // Number of snowflakes in the animation example
#define LOGO_HEIGHT   4
#define LOGO_WIDTH    4
static const unsigned char PROGMEM logo_tree[] =
{
   0x00, 0x00, 0x00, 0x00, 0x00, 0x00, 0x00, 0x00, 0x00, 0x00, 0x00, 0x00, 0x00, 0x00, 0x00, 0x00, 
   0x00, 0x00, 0x00, 0x00, 0x00, 0x00, 0x00, 0x00, 0x00, 0x00, 0x00, 0x03, 0x80, 0x00, 0x00, 0x00, 
   0x00, 0x00, 0x00, 0x00, 0x00, 0x00, 0x00, 0x00, 0x00, 0x00, 0x00, 0x07, 0xc0, 0x00, 0x00, 0x00, 
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   0x00, 0x00, 0x00, 0x00, 0x00, 0x00, 0x00, 0x00, 0x00, 0x00, 0x00, 0x00, 0x00, 0x00, 0x00, 0x00
};
static const unsigned char PROGMEM logo_bmp[] =
{     0x60, 
   0xf0, 
   0xf0, 
   0x60
};
bool merc;
void setup() {
 Serial.begin(9600);
 if(!display.begin(SSD1306_SWITCHCAPVCC, 0x3D)) {
   Serial.println(F("SSD1306 allocation failed"));
   for(;;); // Don't proceed, loop forever
 }
 display.display();
 delay(2000); // Pause for 2 seconds
 merc=digitalRead(7);
 testdrawbitmap();    // Draw a small bitmap image
 testanimate(logo_bmp, LOGO_WIDTH, LOGO_HEIGHT); // Animate bitmaps
}

void loop() {
}
void testdrawbitmap(void) {
 display.clearDisplay();
if (merc==true){
 display.drawBitmap(0,0,logo_tree, 128, 64, 1);
 display.display();
 delay(1000);}
}

////////////////////////////////////
// Working Void
//void setup(){
//  display.begin(SSD1306_SWITCHCAPVCC, 0x3D); //or 0x3C
//  display.clearDisplay(); //for Clearing the display
//  display.drawBitmap(0, 0, myBitmap, 128, 64, WHITE); // display.drawBitmap(x position, y position, bitmap data, bitmap width, bitmap height, color)
//  display.display();
//}
/////////////////////////////////////////////////////////////////////////////////////////////////////////////////////////////////
#define XPOS   0 // Indexes into the 'icons' array in function below
#define YPOS   1
#define DELTAY 2
void testanimate(const uint8_t *bitmap, uint8_t w, uint8_t h) {
 int8_t f, icons[NUMFLAKES][3];
 // Initialize 'snowflake' positions
 for(f=0; f< NUMFLAKES; f++) {
   icons[f][XPOS]   = random(1 - LOGO_WIDTH, display.width());
   icons[f][YPOS]   = -LOGO_HEIGHT;
   icons[f][DELTAY] = random(1, 6);
   Serial.print(F("x: "));
   Serial.print(icons[f][XPOS], DEC);
   Serial.print(F(" y: "));
   Serial.print(icons[f][YPOS], DEC);
   Serial.print(F(" dy: "));
   Serial.println(icons[f][DELTAY], DEC);
 }
 for(int i=0;i<10;i++) {
   display.clearDisplay(); // Clear the display buffer
 display.drawBitmap(0,0,logo_tree, 128, 64, 1);
 display.display();
   // Draw each snowflake:
   for(f=0; f< NUMFLAKES; f++) {
     display.drawBitmap( icons[f][YPOS],icons[f][XPOS], bitmap, 4, 4, WHITE);
   }
   display.display(); // Show the display buffer on the screen
  delay(50);        // Pause for 1/10 second
   // Then update coordinates of each flake...
   for(f=0; f< NUMFLAKES; f++) { icons[f][YPOS] += icons[f][DELTAY]; // If snowflake is off the bottom of the screen... if (icons[f][XPOS] >= display.height()) {
       // Reinitialize to a random position, just off the top
       icons[f][XPOS]   = random(1 - LOGO_WIDTH, display.width());
       icons[f][YPOS]   = -LOGO_HEIGHT;
       icons[f][DELTAY] = random(1, 6);
     }
   }
 }
} 


////////////////////////////////////////////////////////////////////////////////////////////////////////////////////////////////////////////
//#include <Wire.h>
//#include <Adafruit_GFX.h>
//#include <Adafruit_SSD1306.h>

//#define OLED_RESET 4
//Adafruit_SSD1306 display(128, 64, &Wire, OLED_RESET);

//Paste your bitmap here

//void setup(){
//  display.begin(SSD1306_SWITCHCAPVCC, 0x3D); //or 0x3C
//  display.clearDisplay(); //for Clearing the display
//  display.drawBitmap(0, 0, myBitmap, 128, 64, WHITE); // display.drawBitmap(x position, y position, bitmap data, bitmap width, bitmap height, color)
//  display.display();
//}

//void loop() { }

/////////////////////////////////////////////////////////////////////////////////////////////////////////////////////
